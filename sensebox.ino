#include <Adafruit_NeoPixel.h>
#include <DHT.h>
#include <Wire.h>
#include <U8g2lib.h>

// Pin yang digunakan
#define LDR_PIN 34   // Pin analog untuk LDR
#define LED_PIN 27   // Pin untuk data WS2812B
#define NUM_LEDS 8   // Jumlah LED WS2812B (sesuaikan jika lebih)
#define DHT_PIN 18   // Pin untuk sensor DHT11
#define DHT_TYPE DHT11  // Jenis sensor DHT
#define BUZZER_PIN 23   // Pin untuk buzzer aktif
#define FLAME_PIN 4
#define BUTTON_BUZZER 14   // GPIO 14 untuk tombol buzzer
#define BUTTON_LED 12      // GPIO 12 untuk tombol LED


// Ambang batas untuk mendeteksi gelap
#define THRESHOLD 1000  // Sesuaikan berdasarkan hasil pembacaan LDR

// Inisialisasi LED WS2812B
Adafruit_NeoPixel strip(NUM_LEDS, LED_PIN, NEO_GRB + NEO_KHZ800);
DHT dht(DHT_PIN, DHT_TYPE);

// Inisialisasi layar OLED dengan U8g2 (SH1106 / SSD1306 dengan I2C)
U8G2_SSD1306_128X64_NONAME_F_HW_I2C u8g2(U8G2_R0, /* reset=*/ U8X8_PIN_NONE);

static const unsigned char image_download_bits[] = {0xf8,0xff,0x3f,0x00,0xfc,0xff,0x7f,0x00,0xfe,0xff,0xff,0x00,0xff,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0x3f,0x00};
static const unsigned char image_thermometer_1_bits[] = {0x00,0x00,0xf0,0x01,0x00,0x00,0x00,0x00,0xfc,0x07,0x00,0x00,0x00,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0x00,0x00};
static const unsigned char image_degree_bits[] = {0x1c,0x22,0x41,0x41,0x41,0x22,0x1c};
static const unsigned char image_lock_1_bits[] = {0x60,0x00,0x98,0x00,0x08,0x01,0x08,0x00,0xfc,0x03,0x04,0x02,0x64,0x02,0x64,0x02,0x64,0x02,0x04,0x02,0xfc,0x03};
static const unsigned char image_icons8_humidity_50__2__bits[] = {0x00,0x00,0x00,0x00,0x00,0xc0,0x1f,0x00,0x40,0x00,0xc0,0x1f,0x00,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0x00,0x00};
static const unsigned char image_fire_bits[] = {0x00,0x00,0x80,0x01,0x80,0x01,0xc0,0x03,0xe0,0x07,0xf0,0x0f,0xf0,0x0f,0x78,0x1e,0xf8,0x1f,0xb8,0x1d,0xf8,0x1f,0xd8,0x1b,0xd0,0x0b,0xc0,0x03,0x00,0x00,0x00,0x00};
static const unsigned char image_icons8_light_48_49_bits[] = {0x00,0x00,0x3c,0x00,0x00,0x00,0x00,0x3c,0x00,0x00,0x00,0x00,0x3c,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0x00,0x00};
static const unsigned char image_icons8_light_50__1__bits[] = {0x00,0x00,0x00,0x00,0x00,0x00,0x00,0x00,0x00,0x00,0x00,0x00,0x00,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0x00,0x00};
static const unsigned char image_mute_bits[] = {0x41,0x00,0x92,0x01,0x04,0x01,0x4f,0x02,0x1f,0x02,0x3f,0x02,0x5f,0x02,0x98,0x00,0x90,0x01,0x40,0x02};
static const unsigned char image_icons8_light_off_50_bits[] = {0x00,0x00,0x00,0x00,0x00,0x00,0xe0,0x03,0x10,0x04,0x48,0x0d,0xc8,0x09,0xc8,0x09,0x48,0x0d,0x10,0x04,0x20,0x02,0xe0,0x03,0x00,0x00,0xc0,0x01,0x00,0x00};
static const unsigned char image_Layer_2_bits[] = {0xfc,0x01,0x00,0x00,0x00,0x00,0x80,0x3f,0x00,0x00,0x00,0x8e,0x01,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0x61,0x38};


int displayState = 0;
unsigned long lastUpdate = 0;
const unsigned long displayInterval = 1000; // Interval tampilan 2 detik
bool isLEDOn = false;
bool isBuzzerOn = false;
bool fire = false;
bool btnBuzzer = false;
bool btnLED = false;
bool lastButtonBuzzerState = HIGH;
bool lastButtonLEDState = HIGH;

int ldrValue = 0;
float temperature = 0;
float humidity = 0;


void setup() {
    pinMode(LDR_PIN, INPUT);
    pinMode(BUZZER_PIN, OUTPUT);
    pinMode(FLAME_PIN, INPUT);
    pinMode(BUTTON_BUZZER, INPUT_PULLUP);
    pinMode(BUTTON_LED, INPUT_PULLUP);
    digitalWrite(BUZZER_PIN, LOW); // Pastikan buzzer mati di awal

    Serial.begin(115200);
    strip.begin();
    strip.show(); // Matikan semua LED saat mulai
    dht.begin();
    
    // Inisialisasi layar OLED dengan U8g2
    u8g2.begin();
    splashScreen();
}

void loop() {
    int ldrValue = analogRead(LDR_PIN);  // Membaca nilai dari LDR
    float temperature = dht.readTemperature(); // Membaca suhu dalam Celcius
    float humidity = dht.readHumidity(); // Membaca kelembaban
    int fireStatus = digitalRead(FLAME_PIN);
    int buttonBuzzerState = digitalRead(BUTTON_BUZZER);
    int buttonLEDState = digitalRead(BUTTON_LED);

    // Tampilkan data ke serial monitor
    Serial.print("Nilai LDR: ");
    Serial.print(ldrValue);
    Serial.print(" | Suhu: ");
    Serial.print(temperature);
    Serial.print(" °C | Kelembaban: ");
    Serial.print(humidity);
    Serial.print(" | Sensor Api : ");
    if (fireStatus == LOW) {
        Serial.println("Terdeteksi");
    } else {
        Serial.println("Tidak ada");
    }
    Serial.print(" | BtnBuzz: ");
    Serial.print(btnBuzzer ? "DITEKAN" : "TIDAK");
    Serial.print(" | BtnLED: ");
    Serial.println(btnLED ? "DITEKAN" : "TIDAK");
    delay(500);

    // Perbarui tampilan setiap 2 detik
    if (millis() - lastUpdate > displayInterval) {
        lastUpdate = millis();
        displayState = (displayState + 1) % 3;
    }

    // Menampilkan data di layar OLED
    u8g2.clearBuffer();
    u8g2.setFont(u8g2_font_fub20_tr);

    if (displayState == 0) {
        if (isLEDOn == true) {
          u8g2.drawXBM(5, 12, 40, 40, image_icons8_light_48_49_bits);
          u8g2.setFont(u8g2_font_helvB24_tr);
          u8g2.setCursor(52, 45);
          u8g2.print(ldrValue);
        } else {
          u8g2.drawXBM(2, 11, 42, 42, image_icons8_light_50__1__bits);
          u8g2.setFont(u8g2_font_helvB24_tr);
          u8g2.setCursor(52, 45);
          u8g2.print(ldrValue);
        }
    } else if (displayState == 1) {
        u8g2.drawXBM(2, 11, 45, 45, image_thermometer_1_bits);
        u8g2.setFont(u8g2_font_helvB24_tr);
        u8g2.setCursor(52, 45);
        u8g2.print((int)temperature);
        u8g2.drawXBM(93, 23, 7, 7, image_degree_bits);
        u8g2.setCursor(97, 45);
        u8g2.print(" C");
    } else {

        u8g2.drawXBM(7, 15, 35, 35, image_icons8_humidity_50__2__bits);
        u8g2.setFont(u8g2_font_helvB24_tr);
        u8g2.setCursor(55, 45);
        u8g2.print((int)humidity);
        u8g2.print("%");
    }

    //   if (isTouchActive == true) {
    //   u8g2.drawXBM(110.5, 3.5, 11, 11, image_lock_1_bits);
    // }

    if (fireStatus == LOW) {
      fire = true;
    } else {
      fire = false;
    }

    if (fire == true) {
      u8g2.drawXBM(53, 0, 16, 16, image_fire_bits);
    }

    if (btnBuzzer) {
    u8g2.drawXBM(81, 3, 10, 10, image_mute_bits);
    }

    if (btnLED) {
    u8g2.drawXBM(102, 0, 15, 15, image_icons8_light_off_50_bits);
    }

    u8g2.sendBuffer();


   // Logika Buzzer
    if ((temperature > 39 || fire) && !btnBuzzer) { 
        digitalWrite(BUZZER_PIN, HIGH);
        isBuzzerOn = true;
    } else {
        digitalWrite(BUZZER_PIN, LOW);
        isBuzzerOn = false;
    }

    // Jika tombol buzzer ditekan, matikan buzzer manual
     if (buttonBuzzerState == LOW && lastButtonBuzzerState == HIGH) {
        btnBuzzer = !btnBuzzer;
        isBuzzerOn = !btnBuzzer;
        digitalWrite(BUZZER_PIN, LOW);
        delay(300);
    }
    lastButtonBuzzerState = buttonBuzzerState;



    // Jika tombol LED ditekan, matikan LED manual
    if (buttonLEDState == LOW && lastButtonLEDState == HIGH) {
        btnLED = !btnLED;
        // isLEDOn = false;
        isLEDOn = !btnLED;
        // setColor(0, 0, 0); 
        delay(300);
    }
    lastButtonLEDState = buttonLEDState;

            // **Logika LED berdasarkan LDR dan tombol**
    if (!btnLED) {  // Jika tombol belum ditekan, kontrol LED dengan LDR
        if (ldrValue < THRESHOLD) {
            setColor(255, 255, 102);  // LED hijau jika gelap
            isLEDOn = true;
        } else {
            setColor(0, 0, 0);  // Matikan LED jika terang
            isLEDOn = false;
        }
    } else {  
        setColor(0, 0, 0);  // Jika tombol ditekan, LED mati manual
    }

// // **Logika LED**
// if (manualTouch) {  
//     setColor(0, 0, 0);  // Matikan LED hanya jika sentuhan manual
//     isLEDOn = false;
// } else {
//     if (ldrValue < THRESHOLD) {  
//         setColor(255, 255, 153);  // LED menyala hijau kekuningan jika gelap
//         isLEDOn = true;
//     } else {  
//         setColor(0, 0, 0);  // Matikan LED jika terang
//         isLEDOn = false;
//     }


    // // **Logika Buzzer**
    // if (fire || temperature > 39) {  
    //     isBuzzerOn = true;
    // } else {  
    //     isBuzzerOn = false;
    // }
    // // Kontrol output buzzer
    // digitalWrite(BUZZER_PIN, isBuzzerOn ? HIGH : LOW);

    delay(100);
}

void setColor(int r, int g, int b) {
    for (int i = 0; i < NUM_LEDS; i++) {
        strip.setPixelColor(i, strip.Color(r, g, b));
    }
    strip.show();
}


void splashScreen() {
    u8g2.clearBuffer();

    u8g2.drawXBM(21, 28, 86, 13, image_Layer_2_bits);
    u8g2.sendBuffer();
    delay(1500);  // Tampilkan selama 500ms

    u8g2.clearBuffer(); // Bersihkan sebelum masuk ke tampilan utama
}